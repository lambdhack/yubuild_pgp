## packages/libyubikey/Config.in
```kconfig
config BR2_PACKAGE_LIBYUBIKEY
    bool "libyubikey"
    help
        libyubikey
        
        https://github.com/Yubico/yubico-c
```

## packages/yubikey-manager/Config.in
```kconfig
config BR2_PACKAGE_YUBIKEY_MANAGER
    bool "yubikey-manager"
    depends on BR2_PACKAGE_YUBIKEY_PERSONALIZATION
    select BR2_PACKAGE_PYTHON3
    help
        yubikey-manager
        
        https://github.com/Yubico/yubikey-manager
```

## packages/yubikey-personalization/Config.in
```kconfig
config BR2_PACKAGE_YUBIKEY_PERSONALIZATION
    bool "yubikey-personalization"
    depends on BR2_PACKAGE_LIBYUBIKEY
    select BR2_PACKAGE_LIBJSON
    select BR2_PACKAGE_LIBUSB
    select BR2_PACKAGE_LIBXSLT
    help
        yubikey-personalization
        
        https://github.com/Yubico/yubikey-personalization
```
